## package/vtm-tools/vtm-abduco/Config.in
```kconfig
menuconfig BR2_PACKAGE_ABDUCO
	bool "abduco"
	help
		abduco provides session management i.e. it allows programs to be run independently from their 
		controlling terminal. That is programs can be detached - run in the background - and then later 
		reattached. Together with dvtm it provides a simpler and cleaner alternative to tmux or screen.

		https://www.brain-dump.org/projects/abduco
```

## package/vtm-tools/vtm-rtty/Config.in
```kconfig
config BR2_PACKAGE_RTTY
	bool "vtm-rtty"
	depends on BR2_USE_MMU # fork()
	select BR2_PACKAGE_LIBEV
	help
	  Access your device's terminal from anywhere via the web.

	  https://github.com/zhaojh329/rtty
```

## package/vtm-tools/vtm-rttys-go/Config.in
```kconfig
menuconfig BR2_PACKAGE_RTTYS_GOLANG
	bool "vtm-rttys-go"
	depends on BR2_PACKAGE_HOST_GO_TARGET_ARCH_SUPPORTS
	help
		**************************
```

## package/vtm-tools/vtm-slmenu/Config.in
```kconfig
menuconfig BR2_PACKAGE_SLMENU
	bool "slmenu"

	help
	  slmenu is a dmenu clone for the console.
	  https://github.com/joshaw/slmenu
```
